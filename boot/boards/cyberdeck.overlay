/*
 * Copyright (c) 2026 Core Devices LLC
 * SPDX-License-Identifier: Apache-2.0
 */

/ {
	chosen {
		/* we are the bootloader */
		zephyr,code-partition = &boot_partition;

		/* fixed internal firmware image and external staged images */
		pb,firmware = &firmware_partition;
		pb,external-flash = &w25q256jw;
		pb,firmware-scratch = &firmware_scratch_partition;
		pb,safe-firmware = &safe_firmware_partition;
		pb,prf = &prf_partition;

		/* buttons */
		pb,btn-back = &btn_back;
		pb,btn-up = &btn_up;
		pb,btn-center = &btn_center;
		pb,btn-down = &btn_down;

		/* watchdog */
		pb,wdt = &wdt0;
	};
};
