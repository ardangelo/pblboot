## boards/coredevices/cyberdeck/Kconfig.cyberdeck
```kconfig
# Copyright (c) 2026 Core Devices LLC
# SPDX-License-Identifier: Apache-2.0

config BOARD_CYBERDECK
	select SOC_NRF52840_QIAA
```

## boards/coredevices/cyberdeck/board.yml
```yaml
# Copyright (c) 2026 Core Devices LLC
# SPDX-License-Identifier: Apache-2.0

board:
  name: cyberdeck
  full_name: Cyberdeck
  vendor: coredevices
  socs:
    - name: nrf52840
```

## boards/coredevices/cyberdeck/cyberdeck_defconfig
```kconfig
# Copyright (c) 2026 Core Devices LLC
# SPDX-License-Identifier: Apache-2.0

CONFIG_GPIO=y
CONFIG_FLASH=y
CONFIG_WATCHDOG=y

CONFIG_CLOCK_CONTROL=y
CONFIG_CLOCK_CONTROL_NRF_K32SRC_XTAL=y
CONFIG_CLOCK_CONTROL_NRF_K32SRC_50PPM=y

CONFIG_NRF_ENABLE_ICACHE=y
```

## boot/Kconfig
```kconfig
# Copyright (c) 2025 Core Devices LLC
# SPDX-License-Identifier: Apache-2.0

menu "Zephyr"
source "Kconfig.zephyr"
endmenu

module = PBLBOOT
module-str = pblboot
source "subsys/logging/Kconfig.template.log_config"

config PB_FLASH_READ_BUF_SIZE
	int "Flash read buffer size"
	default 512
	help
	  Size of the flash read buffer.

config PB_PRF_BUTTON_COMBO_TIME_MS
	int "PRF button combo time (ms)"
	default 5000
	help
	  Time in milliseconds that the PRF button combo must be held to trigger
	  a PRF load.

config PB_DFU_BUTTON_TIME_MS
	int "USB DFU button hold time (ms)"
	default 1000
	help
	  Time in milliseconds that END CALL must be held to trigger USB DFU.

config PB_USB_DFU
	bool "Enable Cyberdeck TinyUSB DFU"
	depends on PB_FIRMWARE_NRF52_STAGED_UPDATE
	depends on SOC_SERIES_NRF52X
	help
	  Enable TinyUSB DFU for 12-byte-descriptor firmware images in
	  external scratch flash.

config PB_USB_DFU_POLLTIMEOUT_MS
	int "USB DFU poll timeout (ms)"
	default 50
	depends on PB_USB_DFU
	help
	  Timeout reported to the host for flash writes and erases.

config PB_USB_DFU_IDLE_TIMEOUT_MS
	int "USB DFU idle timeout (ms)"
	default 60000
	depends on PB_USB_DFU
	help
	  Time to wait in USB DFU before a host starts a transfer.

config PB_USB_DFU_TRANSFER_TIMEOUT_MS
	int "USB DFU transfer timeout (ms)"
	default 300000
	depends on PB_USB_DFU
	help
	  Time to wait for additional USB DFU activity once a transfer starts.

config PB_WATCHDOG_TIMEOUT_MS
	int "Watchdog timeout (ms)"
	default 10000
	help
	  Timeout in milliseconds for the watchdog timer.

config PB_WATCHDOG_AUTOSTART
	bool "Start the watchdog during early boot"
	default y
	help
	  Start the watchdog in pb_watchdog_init(). Disable on SoCs whose
	  watchdog cannot be stopped once started (e.g. nRF52) and whose firmware
	  does not adopt and feed a bootloader-started watchdog in time: starting
	  it would hand firmware a running watchdog it cannot keep fed, causing a
	  reset loop. When disabled the watchdog is installed but left stopped.

config PB_CHARGER
	bool "Enable charger support"
	default y
	help
	  Enable support for the battery charger.

config PB_FIRMWARE_NRF52
	bool "Boot fixed internal NRF52 firmware image"
	depends on SOC_SERIES_NRF52X
	help
	  Boot the firmware image directly from the internal-flash firmware
	  partition instead of selecting XIP slots from external flash.


config PB_FIRMWARE_NRF52_STAGED_UPDATE
	bool "Enable staged external-flash updates for NRF52 firmware"
	depends on PB_FIRMWARE_NRF52
	help
	  Validate 12-byte-descriptor firmware images in external flash and
	  copy verified payloads into the fixed internal NRF52 firmware partition.

config PB_FIRMWARE_PLATFORM_ID
	int "Staged NRF52 firmware platform ID"
	depends on PB_FIRMWARE_NRF52_STAGED_UPDATE
	range 0 255
	default 0
	help
	  Expected hardware platform in the staged firmware metadata footer.

config PB_VBAT_MIN_BOOT_MV
	int "Minimal battery level to allow boot (mV)"
	default 3300
	depends on PB_CHARGER
	help
	  Minimal battery voltage in millivolts required to allow booting the
	  system. If watch is plugged in boot will be allowed regardless of
	  the battery voltage.
```

## boot/sample.yaml
```yaml
# Copyright (c) 2025 Core Devices LLC
# SPDX-License-Identifier: Apache-2.0

sample:
  description: PebbleOS bootloader
  name: pblboot
common:
  build_only: true
  integration_platforms:
    - pt2
    - pr2
    - cyberdeck/nrf52840
tests:
  boot.default: {}
```

## lib/pb/bootbit/Kconfig
```kconfig
# Copyright (c) 2025 Core Devices LLC
# SPDX-License-Identifier: Apache-2.0

config PB_BOOTBIT
    bool "Boot bit library"
    help
      Enable the boot bit library.


if PB_BOOTBIT

module = PB_BOOTBIT
module-str = pb_bootbit
source "subsys/logging/Kconfig.template.log_config"

config PB_BOOTBIT_SF32LB
    bool "Boot bit SF32LB backend"
    default y if SOC_FAMILY_SF32
    depends on SOC_FAMILY_SF32
    help
      Enable boot bit SF32LB backend.

config PB_BOOTBIT_NRF52
    bool "Boot bit NRF52 retained RAM backend"
    default y if SOC_SERIES_NRF52X
    depends on SOC_SERIES_NRF52X
    help
      Enable boot bit NRF52 retained RAM backend.

endif # BOOTBIT
```
